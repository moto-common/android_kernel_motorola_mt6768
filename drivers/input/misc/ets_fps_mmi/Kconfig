## drivers/input/misc/ets_fps_mmi/Kconfig
```kconfig
config INPUT_EGISTEC_FPS
	tristate "Egistec fingerprint sensor MMI"
	default n
	help
	 Say Y here if you wish to include support for MMI EGIS finger print sensor.
	 If unsure, say N.
```

## drivers/input/touchscreen/focaltech_mtk_v2_mmi/Kconfig
```kconfig
#
# Focaltech Touchscreen driver configuration
#

config TOUCHSCREEN_FTS_MTK_V2_MMI
	tristate "Moto Focaltech Touchscreen"
	depends on I2C
	default n
	help
	  Say Y here if you have Moto Focaltech touch panel.
	  If unsure, say N.

config INPUT_FOCALTECH_MTK_V2_MMI_IC_NAME_FT3518U
	bool "Focaltech Chip FT3518U"
	depends on TOUCHSCREEN_FTS_MTK_V2_MMI
	default n
	help
	  Say Y here to enable support for Focaltech FT3518U touch panel.
	  If unsure, say N.

config INPUT_FOCALTECH_MTK_V2_MMI_IC_NAME_FT3519
	bool "Focaltech Chip FT3519"
	depends on TOUCHSCREEN_FTS_MTK_V2_MMI
	default n
	help
	  Say Y here to enable support for Focaltech FT3519 touch panel.
	  If unsure, say N.

config INPUT_FOCALTECH_MTK_V2_MMI_ENABLE_DOUBLE_TAP
	bool "Moto Focaltech Double tap"
	depends on TOUCHSCREEN_FTS_MTK_V2_MMI
	default n
	help
	  Say Y here to enable support for double tap functionality on Focaltech touch panel.
	  If unsure, say N.

config FOCALTECH_FB_PANEL
	bool "Focaltech FB Panel"
	depends on TOUCHSCREEN_FTS_MTK_V2_MMI
	default n
	help
	  Say Y here to enable support for Focaltech FB Panel.
	  If unsure, say N.

config INPUT_FOCALTECH_POWER_RECOVER_EN
	bool "Moto Focaltech Power Recovery"
	depends on TOUCHSCREEN_FTS_MTK_V2_MMI
	default n
	help
	  Say Y here to enable support for power recovery on Focaltech touch panel.
	  If unsure, say N.
```

## drivers/input/touchscreen/goodix_mtk_gtx8_mmi/Kconfig
```kconfig
config GOODIX_MTK_GTX8_MMI
	tristate "Goodix MTK GTX8 MMI"
	depends on I2C && SENSORS_CLASS
	default n
	help
	  Say Y here to build the Goodix MTK GTX8 MMI driver as a module.
	  If unsure, say N.

config GOODIX_MTK_GTX8_TS_TOOLS_MMI
	tristate "Goodix MTK GTX8 TS Tools MMI"
	depends on I2C && GOODIX_MTK_GTX8_MMI
	default n
	help
	  Say Y here to build the Goodix MTK GTX8 TS Tools MMI driver as a module.
	  If unsure, say N.

config GOODIX_MTK_GTX8_GESTURE_MMI
	tristate "Goodix MTK GTX8 Gesture MMI"
	depends on I2C && GOODIX_MTK_GTX8_MMI
	default n
	help
	  Say Y here to build the Goodix MTK GTX8 Gesture MMI driver as a module.
	  If unsure, say N.

config GOODIX_FB_PANEL
	bool "Goodix FB Panel"
	depends on GOODIX_MTK_GTX8_MMI
	default n
	help
	  Say Y here to enable support for Goodix FB Panel.
	  If unsure, say N.

config GOODIX_CHG_DETECTION
	bool "Goodix Charger Detection"
	depends on GOODIX_MTK_GTX8_MMI
	default n
	help
	  Say Y here to enable support for Goodix Charger Detection.
	  If unsure, say N.

config INPUT_GTX_MTK_MMI_ENABLE_DOUBLE_TAP
	bool "Goodix Double Tap"
	depends on GOODIX_MTK_GTX8_MMI
	default n
	help
	  Say Y here to enable support for double tap functionality on Goodix touch panel.
	  If unsure, say N.
```

## drivers/nfc/st21nfc/Kconfig
```kconfig
config ST21NFC
	tristate "ST21NFC Support"
	depends on I2C
	default n
	help
	  Say Y here to enable support for ST21NFC.
```

## drivers/power/Kconfig
```kconfig
source "drivers/power/avs/Kconfig"
source "drivers/power/reset/Kconfig"
source "drivers/power/supply/Kconfig"
source "drivers/power/bq2597x_mmi/Kconfig"
source "drivers/power/mmi_parallel_charger/Kconfig"
```

## drivers/power/mmi_parallel_charger/Kconfig
```kconfig
config MMI_PARALLEL_CHARGER
	tristate "MMI Parallel Charger Support"
	depends on I2C
	default n
	help
	  Say Y here to enable support for MMI Parallel Charger.
```

## sound/soc/codecs/fs16xx_dlkm/Kconfig
```kconfig
config SND_SOC_FS16XX_DLKM
	tristate "FS16XX SoC Audio Support"
	depends on I2C
	default n
	help
	  Say Y here to enable support for FS16XX SoC Audio.
```
